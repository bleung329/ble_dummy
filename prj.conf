## CMakeLists.txt
```
# SPDX-License-Identifier: Apache-2.0

cmake_minimum_required(VERSION 3.13.1)

include($ENV{ZEPHYR_BASE}/cmake/app/boilerplate.cmake NO_POLICY_SCOPE)
project(skeleton_code)

FILE(GLOB app_sources src/*.c)
target_sources(app PRIVATE
  ${app_sources}
  )
```

## sample.yaml
```
sample:
  name: Bluetooth Beacon
tests:
  sample.bluetooth.beacon:
    harness: bluetooth
    platform_whitelist: qemu_cortex_m3 qemu_x86 nrf52_pca10040
    tags: bluetooth
```

## prj.conf
```kconfig
CONFIG_BT=y
CONFIG_BT_DEBUG_LOG=y
CONFIG_BT_SMP=y
CONFIG_BT_PERIPHERAL=y
CONFIG_BT_GATT_DIS=y
CONFIG_BT_GATT_DIS_PNP=n
CONFIG_BT_DEVICE_NAME="TEST PROJECT YEAH"
CONFIG_BT_DEVICE_APPEARANCE=1024
CONFIG_BT_ATT_ENFORCE_FLOW=n
```

## src/main.c
```c
#include <zephyr/types.h>
#include <stddef.h>
#include <string.h>
#include <errno.h>
#include <sys/byteorder.h>
#include <zephyr.h>
#include <device.h>
#include <drivers/gpio.h>

#include <bluetooth/bluetooth.h>
#include <bluetooth/hci.h>
#include <bluetooth/conn.h>
#include <bluetooth/uuid.h>
#include <bluetooth/gatt.h>

#include "custom.h"

//Anything marked CONFIG is from the proj.conf file
//It allows us to define things and change settings,
//without going into the code.
#define DEVICE_NAME CONFIG_BT_DEVICE_NAME
#define DEVICE_NAME_LEN (sizeof(DEVICE_NAME) - 1)

//GPIO Related things
struct device *dev;
//(Not actually currently using these)
#define LED_PORT	DT_ALIAS_LED0_GPIOS_CONTROLLER
#define LED		DT_ALIAS_LED0_GPIOS_PIN


//Default connection
struct bt_conn *default_conn;

//Advertising data
//I know theres a lot of random pre-defines, 
//use google to find out what they mean.
static const struct bt_data ad[] = {
		BT_DATA_BYTES(BT_DATA_FLAGS, (BT_LE_AD_GENERAL | BT_LE_AD_NO_BREDR)),
		BT_DATA(BT_DATA_NAME_COMPLETE, DEVICE_NAME, DEVICE_NAME_LEN),
};

//The connected callback, what happens when something attempts to connect to this device
static void connected(struct bt_conn *conn, u8_t err)
{
	//Turn on the LED
	//Strangely enough, 0 means on.
	gpio_pin_write(dev, 9, 0);
	if (err)
	{
		//Do nothing
	}
	else
	{
		//Establish our connection
		default_conn = bt_conn_ref(conn);
	}
}

//Our disconnection callback.
static void disconnected(struct bt_conn *conn, u8_t reason)
{
	//Turn off the LED
	gpio_pin_write(dev, 9, 1);

	if (default_conn){
		//Disconnect 
		bt_conn_unref(default_conn);
		default_conn = NULL;
	}
}

//The struct used to hold our callbacks
static struct bt_conn_cb conn_callbacks = {
		.connected = connected,
		.disconnected = disconnected,
};

static void bt_ready(int err)
{
	if (err){return;}

	//Initialize our custom service
	custom_init();

	//Make sure our advertising starts and starts correctly.
	err = bt_le_adv_start(BT_LE_ADV_CONN, ad, ARRAY_SIZE(ad), NULL, 0);
	if (err){return;}
}

void main(void)
{
	//Establish the device
	//(I'm pretty sure pin 9 falls under GPIO 1, just check the device tree)
	dev = device_get_binding("GPIO_1"); 

	//Configure the pin
	//The pins are just numbered, nothing much fancier than that
	//In this case, I'm setting up pin 9 for output
	//Check the devicetree.conf in build/zephyr/include/generated/ for all your alias/gpio needs.
	gpio_pin_configure(dev, 9, GPIO_DIR_OUT); 
	
	//Enable bluetooth, passing the bt_ready function to it
	int err = bt_enable(bt_ready); 
	if (err){return;}

	//Register callbacks
	bt_conn_cb_register(&conn_callbacks); 
	//Turn off LED
	gpio_pin_write(dev, 9, 1);
}
```

## src/custom.c
```c
#include <zephyr/types.h>
#include <stddef.h>
#include <string.h>
#include <errno.h>
#include <zephyr.h>
#include <sys/byteorder.h>


#include <bluetooth/bluetooth.h>
#include <bluetooth/hci.h>
#include <bluetooth/conn.h>
#include <bluetooth/uuid.h>
#include <bluetooth/gatt.h>

#include "custom.h"

//Every service and characteristic gets a UUID.
//The UUIDs you give it can be arbitrary to be honest.
//The bluetooth standard already has a bunch defined though,
//so double check to make sure youre setting a UUID that isn't
//way out of line.
#define BT_UUID_LINK_LOSS BT_UUID_DECLARE_16(0x1802)
#define BT_UUID_ALERT_LEVEL BT_UUID_DECLARE_16(0x2A06)

//The data this service is holding.
//It'll stick around.
u8_t link_loss_alert_level = 0;

//This defines our service.
BT_GATT_SERVICE_DEFINE(custom_service,
    BT_GATT_PRIMARY_SERVICE(BT_UUID_LINK_LOSS),

    //You define the read and write callbacks + permissions here, in the characteristic.
	BT_GATT_CHARACTERISTIC(BT_UUID_ALERT_LEVEL, BT_GATT_CHRC_READ | BT_GATT_CHRC_WRITE,
											    BT_GATT_PERM_READ | BT_GATT_PERM_WRITE, read_level, write_level, NULL),
);

void custom_init()
{
}

//READ
ssize_t read_level(struct bt_conn *conn,
																	 const struct bt_gatt_attr *attr, void *buf,
																	 u16_t len, u16_t offset)
{
	return bt_gatt_attr_read(conn, attr, buf, len, offset, &link_loss_alert_level, sizeof(link_loss_alert_level));
}

//WRITE
ssize_t write_level(struct bt_conn *conn,
																		const struct bt_gatt_attr *attr,
																		const void *buf, u16_t len, u16_t offset,
																		u8_t flags)
{
	//Mainly all left over from the project I dissected.
	const u8_t *new_alert_level = buf;

	if (!len)
	{
		return BT_GATT_ERR(BT_ATT_ERR_INVALID_ATTRIBUTE_LEN);
	}
	if (*new_alert_level >= 0 && *new_alert_level <= 2)
	{
		link_loss_alert_level = *new_alert_level;
	}
	else
	{
		return BT_GATT_ERR(BT_ATT_ERR_VALUE_NOT_ALLOWED);
	}

	return len;
}

u8_t get_level()
{
	return link_loss_alert_level;
}
```

## src/custom.h
```c
//Initialize the service
void custom_init();
//Read callback
ssize_t read_level(struct bt_conn *conn, const struct bt_gatt_attr *attr, void *buf, u16_t len, u16_t offset);
//Write callback
ssize_t write_level(struct bt_conn *conn, const struct bt_gatt_attr *attr, const void *buf, u16_t len, u16_t offset, u8_t flags);

u8_t get_level();
```
